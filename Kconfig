## Kconfig
```kconfig
menuconfig PAW3222
	bool "PAW3222 mouse optical sensor"
	select SPI
	depends on INPUT
	depends on DT_HAS_PIXART_PAW3222_ENABLED
	help
	  Enable PAW3222 mouse optical sensor.
```

## build/left/Kconfig/Kconfig.modules
```kconfig
menu "zmk-pmw3610-driver (/Users/ryosaitoh/Desktop/git/zmk-pmw3610-driver)"
osource "/Users/ryosaitoh/Desktop/git/zmk-pmw3610-driver/Kconfig"
config ZEPHYR_ZMK_PMW3610_DRIVER_MODULE
	bool
	default y
endmenu
menu "zmk-rgbled-widget (/Users/ryosaitoh/Desktop/git/zmk-rgbled-widget)"
osource "/Users/ryosaitoh/Desktop/git/zmk-rgbled-widget/Kconfig"
config ZEPHYR_ZMK_RGBLED_WIDGET_MODULE
	bool
	default y
endmenu
config ZEPHYR_HAL_STM32_MODULE
	bool
	default y

config ZEPHYR_HAL_STM32_MODULE_BLOBS
	bool
menu "lvgl (/Users/ryosaitoh/Desktop/git/modules/lib/gui/lvgl)"
osource "/Users/ryosaitoh/Desktop/git/modules/lib/gui/lvgl/zephyr/Kconfig"
config ZEPHYR_LVGL_MODULE
	bool
	default y
endmenu
config ZEPHYR_ZMK_STUDIO_MESSAGES_MODULE
	bool
	default y
menu "canopennode (/Users/ryosaitoh/Desktop/git/modules/lib/canopennode)"
osource "$(ZEPHYR_CANOPENNODE_KCONFIG)"
config ZEPHYR_CANOPENNODE_MODULE
	bool
	default y
endmenu
menu "chre (/Users/ryosaitoh/Desktop/git/modules/lib/chre)"
osource "/Users/ryosaitoh/Desktop/git/modules/lib/chre/platform/zephyr/Kconfig"
config ZEPHYR_CHRE_MODULE
	bool
	default y
endmenu
menu "lz4 (/Users/ryosaitoh/Desktop/git/modules/lib/lz4)"
osource "$(ZEPHYR_LZ4_KCONFIG)"
config ZEPHYR_LZ4_MODULE
	bool
	default y
endmenu
menu "nanopb (/Users/ryosaitoh/Desktop/git/modules/lib/nanopb)"
osource "$(ZEPHYR_NANOPB_KCONFIG)"
config ZEPHYR_NANOPB_MODULE
	bool
	default y
endmenu
config ZEPHYR_PSA_ARCH_TESTS_MODULE
	bool
	default y
menu "sof (/Users/ryosaitoh/Desktop/git/modules/audio/sof)"
osource "/Users/ryosaitoh/Desktop/git/modules/audio/sof/zephyr/Kconfig"
config ZEPHYR_SOF_MODULE
	bool
	default y
endmenu
config ZEPHYR_TF_M_TESTS_MODULE
	bool
	default y
menu "tflite-micro (/Users/ryosaitoh/Desktop/git/optional/modules/lib/tflite-micro)"
osource "$(ZEPHYR_TFLITE_MICRO_KCONFIG)"
config ZEPHYR_TFLITE_MICRO_MODULE
	bool
	default y
endmenu
menu "thrift (/Users/ryosaitoh/Desktop/git/optional/modules/lib/thrift)"
osource "$(ZEPHYR_THRIFT_KCONFIG)"
config ZEPHYR_THRIFT_MODULE
	bool
	default y
endmenu
menu "lang-rust (/Users/ryosaitoh/Desktop/git/modules/lang/rust)"
osource "/Users/ryosaitoh/Desktop/git/modules/lang/rust/Kconfig"
config ZEPHYR_LANG_RUST_MODULE
	bool
	default y
endmenu
menu "zscilib (/Users/ryosaitoh/Desktop/git/modules/lib/zscilib)"
osource "/Users/ryosaitoh/Desktop/git/modules/lib/zscilib/Kconfig.zscilib"
config ZEPHYR_ZSCILIB_MODULE
	bool
	default y
endmenu
menu "acpica (/Users/ryosaitoh/Desktop/git/modules/lib/acpica)"
osource "$(ZEPHYR_ACPICA_KCONFIG)"
config ZEPHYR_ACPICA_MODULE
	bool
	default y
endmenu
menu "cmsis (/Users/ryosaitoh/Desktop/git/modules/hal/cmsis)"
osource "$(ZEPHYR_CMSIS_KCONFIG)"
config ZEPHYR_CMSIS_MODULE
	bool
	default y
endmenu
menu "cmsis-dsp (/Users/ryosaitoh/Desktop/git/modules/lib/cmsis-dsp)"
osource "$(ZEPHYR_CMSIS_DSP_KCONFIG)"
config ZEPHYR_CMSIS_DSP_MODULE
	bool
	default y
endmenu
menu "cmsis-nn (/Users/ryosaitoh/Desktop/git/modules/lib/cmsis-nn)"
osource "$(ZEPHYR_CMSIS_NN_KCONFIG)"
config ZEPHYR_CMSIS_NN_MODULE
	bool
	default y
endmenu
menu "fatfs (/Users/ryosaitoh/Desktop/git/modules/fs/fatfs)"
osource "$(ZEPHYR_FATFS_KCONFIG)"
config ZEPHYR_FATFS_MODULE
	bool
	default y
endmenu
config ZEPHYR_ADI_MODULE
	bool
	default y
menu "hal_ambiq (/Users/ryosaitoh/Desktop/git/modules/hal/ambiq)"
osource "$(ZEPHYR_HAL_AMBIQ_KCONFIG)"
config ZEPHYR_HAL_AMBIQ_MODULE
	bool
	default y
endmenu
config ZEPHYR_ATMEL_MODULE
	bool
	default y
menu "hal_espressif (/Users/ryosaitoh/Desktop/git/modules/hal/espressif)"
osource "/Users/ryosaitoh/Desktop/git/modules/hal/espressif/zephyr/Kconfig"
config ZEPHYR_HAL_ESPRESSIF_MODULE
	bool
	default y

config ZEPHYR_HAL_ESPRESSIF_MODULE_BLOBS
	bool
endmenu
menu "hal_ethos_u (/Users/ryosaitoh/Desktop/git/modules/hal/ethos_u)"
osource "$(ZEPHYR_HAL_ETHOS_U_KCONFIG)"
config ZEPHYR_HAL_ETHOS_U_MODULE
	bool
	default y
endmenu
menu "hal_gigadevice (/Users/ryosaitoh/Desktop/git/modules/hal/gigadevice)"
osource "$(ZEPHYR_HAL_GIGADEVICE_KCONFIG)"
config ZEPHYR_HAL_GIGADEVICE_MODULE
	bool
	default y
endmenu
menu "hal_intel (/Users/ryosaitoh/Desktop/git/modules/hal/intel)"
osource "/Users/ryosaitoh/Desktop/git/modules/hal/intel/zephyr/Kconfig"
config ZEPHYR_HAL_INTEL_MODULE
	bool
	default y
endmenu
menu "hal_nordic (/Users/ryosaitoh/Desktop/git/modules/hal/nordic)"
osource "$(ZEPHYR_HAL_NORDIC_KCONFIG)"
config ZEPHYR_HAL_NORDIC_MODULE
	bool
	default y

config ZEPHYR_HAL_NORDIC_MODULE_BLOBS
	bool
endmenu
config ZEPHYR_NUVOTON_MODULE
	bool
	default y
config ZEPHYR_QUICKLOGIC_MODULE
	bool
	default y
config ZEPHYR_HAL_RENESAS_MODULE
	bool
	default y

config ZEPHYR_HAL_RENESAS_MODULE_BLOBS
	bool
menu "hal_rpi_pico (/Users/ryosaitoh/Desktop/git/modules/hal/rpi_pico)"
osource "$(ZEPHYR_HAL_RPI_PICO_KCONFIG)"
config ZEPHYR_HAL_RPI_PICO_MODULE
	bool
	default y
endmenu
menu "hal_silabs (/Users/ryosaitoh/Desktop/git/modules/hal/silabs)"
osource "$(ZEPHYR_HAL_SILABS_KCONFIG)"
config ZEPHYR_HAL_SILABS_MODULE
	bool
	default y

config ZEPHYR_HAL_SILABS_MODULE_BLOBS
	bool
endmenu
menu "hal_tdk (/Users/ryosaitoh/Desktop/git/modules/hal/tdk)"
osource "$(ZEPHYR_HAL_TDK_KCONFIG)"
config ZEPHYR_HAL_TDK_MODULE
	bool
	default y
endmenu
menu "hal_telink (/Users/ryosaitoh/Desktop/git/modules/hal/telink)"
osource "/Users/ryosaitoh/Desktop/git/modules/hal/telink/Kconfig"
config ZEPHYR_HAL_TELINK_MODULE
	bool
	default y
endmenu
menu "hal_wch (/Users/ryosaitoh/Desktop/git/modules/hal/wch)"
osource "$(ZEPHYR_HAL_WCH_KCONFIG)"
config ZEPHYR_HAL_WCH_MODULE
	bool
	default y
endmenu
config ZEPHYR_HAL_WURTHELEKTRONIK_MODULE
	bool
	default y
menu "hostap (/Users/ryosaitoh/Desktop/git/modules/lib/hostap)"
osource "$(ZEPHYR_HOSTAP_KCONFIG)"
config ZEPHYR_HOSTAP_MODULE
	bool
	default y
endmenu
menu "liblc3 (/Users/ryosaitoh/Desktop/git/modules/lib/liblc3)"
osource "$(ZEPHYR_LIBLC3_KCONFIG)"
config ZEPHYR_LIBLC3_MODULE
	bool
	default y
endmenu
config ZEPHYR_LIBMCTP_MODULE
	bool
	default y
config ZEPHYR_LIBMETAL_MODULE
	bool
	default y
menu "littlefs (/Users/ryosaitoh/Desktop/git/modules/fs/littlefs)"
osource "$(ZEPHYR_LITTLEFS_KCONFIG)"
config ZEPHYR_LITTLEFS_MODULE
	bool
	default y
endmenu
menu "mbedtls (/Users/ryosaitoh/Desktop/git/modules/crypto/mbedtls)"
osource "$(ZEPHYR_MBEDTLS_KCONFIG)"
config ZEPHYR_MBEDTLS_MODULE
	bool
	default y
endmenu
config ZEPHYR_MIPI_SYS_T_MODULE
	bool
	default y
menu "nrf_wifi (/Users/ryosaitoh/Desktop/git/modules/lib/nrf_wifi)"
osource "$(ZEPHYR_NRF_WIFI_KCONFIG)"
config ZEPHYR_NRF_WIFI_MODULE
	bool
	default y

config ZEPHYR_NRF_WIFI_MODULE_BLOBS
	bool
endmenu
config ZEPHYR_OPEN_AMP_MODULE
	bool
	default y
menu "percepio (/Users/ryosaitoh/Desktop/git/modules/debug/percepio)"
osource "/Users/ryosaitoh/Desktop/git/modules/debug/percepio/zephyr/Kconfig"
config ZEPHYR_PERCEPIO_MODULE
	bool
	default y
endmenu
menu "picolibc (/Users/ryosaitoh/Desktop/git/modules/lib/picolibc)"
osource "/Users/ryosaitoh/Desktop/git/modules/lib/picolibc/zephyr/Kconfig"
config ZEPHYR_PICOLIBC_MODULE
	bool
	default y
endmenu
menu "segger (/Users/ryosaitoh/Desktop/git/modules/debug/segger)"
osource "$(ZEPHYR_SEGGER_KCONFIG)"
config ZEPHYR_SEGGER_MODULE
	bool
	default y
endmenu
config ZEPHYR_TINYCRYPT_MODULE
	bool
	default y
menu "trusted-firmware-a (/Users/ryosaitoh/Desktop/git/modules/tee/tf-a/trusted-firmware-a)"
osource "$(ZEPHYR_TRUSTED_FIRMWARE_A_KCONFIG)"
config ZEPHYR_TRUSTED_FIRMWARE_A_MODULE
	bool
	default y
endmenu
menu "uoscore-uedhoc (/Users/ryosaitoh/Desktop/git/modules/lib/uoscore-uedhoc)"
osource "$(ZEPHYR_UOSCORE_UEDHOC_KCONFIG)"
config ZEPHYR_UOSCORE_UEDHOC_MODULE
	bool
	default y
endmenu
menu "zcbor (/Users/ryosaitoh/Desktop/git/modules/lib/zcbor)"
osource "$(ZEPHYR_ZCBOR_KCONFIG)"
config ZEPHYR_ZCBOR_MODULE
	bool
	default y
endmenu
menu "module (/Users/ryosaitoh/Desktop/git/zmk/app/module)"
osource "/Users/ryosaitoh/Desktop/git/zmk/app/module/Kconfig"
config ZEPHYR_MODULE_MODULE
	bool
	default y
endmenu
config ZEPHYR_KEYMAP_MODULE_MODULE
	bool
	default y
menu "prospector-zmk-module (/Users/ryosaitoh/Desktop/git/modules/prospector-zmk-module)"
osource "/Users/ryosaitoh/Desktop/git/modules/prospector-zmk-module/Kconfig"
config ZEPHYR_PROSPECTOR_ZMK_MODULE_MODULE
	bool
	default y
endmenu
config ZEPHYR_NRF_HW_MODELS_MODULE
	bool
	default y
```

## build/left/Kconfig/boards/Kconfig.defconfig
```kconfig
# Load Zephyr board defconfig descriptions.
osource "/Users/ryosaitoh/Desktop/git/zephyr/boards/seeed/xiao_ble/Kconfig.defconfig"
```

## build/left/Kconfig/boards/Kconfig.sysbuild
```kconfig
# Load Sysbuild board Kconfig descriptions.
osource "/Users/ryosaitoh/Desktop/git/zephyr/boards/seeed/xiao_ble/Kconfig.sysbuild"
```

## build/left/Kconfig/boards/Kconfig.xiao_ble
```kconfig
# Load board Kconfig descriptions.
osource "/Users/ryosaitoh/Desktop/git/zephyr/boards/seeed/xiao_ble/Kconfig.xiao_ble"
```
