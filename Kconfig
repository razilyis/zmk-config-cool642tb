## build/left/Kconfig/soc/Kconfig.soc
```kconfig
# Load SoC Kconfig descriptions.
osource "/Users/ryosaitoh/Desktop/git/zephyr/soc/xlnx/zynqmp/Kconfig.soc"
osource "/Users/ryosaitoh/Desktop/git/zephyr/soc/xlnx/zynq7000/Kconfig.soc"
osource "/Users/ryosaitoh/Desktop/git/zephyr/soc/xen/Kconfig.soc"
osource "/Users/ryosaitoh/Desktop/git/zephyr/soc/wch/ch32v/Kconfig.soc"
osource "/Users/ryosaitoh/Desktop/git/zephyr/soc/ti/simplelink/Kconfig.soc"
osource "/Users/ryosaitoh/Desktop/git/zephyr/soc/ti/lm3s6965/Kconfig.soc"
osource "/Users/ryosaitoh/Desktop/git/zephyr/soc/ti/k3/Kconfig.soc"
osource "/Users/ryosaitoh/Desktop/git/zephyr/soc/telink/tlsr/Kconfig.soc"
osource "/Users/ryosaitoh/Desktop/git/zephyr/soc/starfive/jh71xx/Kconfig.soc"
osource "/Users/ryosaitoh/Desktop/git/zephyr/soc/st/stm32/Kconfig.soc"
osource "/Users/ryosaitoh/Desktop/git/zephyr/soc/snps/qemu_arc/Kconfig.soc"
osource "/Users/ryosaitoh/Desktop/git/zephyr/soc/snps/nsim/arc_v/Kconfig.soc"
osource "/Users/ryosaitoh/Desktop/git/zephyr/soc/snps/nsim/arc_classic/Kconfig.soc"
osource "/Users/ryosaitoh/Desktop/git/zephyr/soc/snps/hsdk4xd/Kconfig.soc"
osource "/Users/ryosaitoh/Desktop/git/zephyr/soc/snps/hsdk/Kconfig.soc"
osource "/Users/ryosaitoh/Desktop/git/zephyr/soc/snps/emsk/Kconfig.soc"
osource "/Users/ryosaitoh/Desktop/git/zephyr/soc/snps/emsdp/Kconfig.soc"
osource "/Users/ryosaitoh/Desktop/git/zephyr/soc/snps/arc_iot/Kconfig.soc"
osource "/Users/ryosaitoh/Desktop/git/zephyr/soc/silabs/Kconfig.soc"
osource "/Users/ryosaitoh/Desktop/git/zephyr/soc/sifive/sifive_freedom/Kconfig.soc"
osource "/Users/ryosaitoh/Desktop/git/zephyr/soc/sensry/Kconfig.soc"
osource "/Users/ryosaitoh/Desktop/git/zephyr/soc/rockchip/Kconfig.soc"
osource "/Users/ryosaitoh/Desktop/git/zephyr/soc/renode/riscv_virtual/Kconfig.soc"
osource "/Users/ryosaitoh/Desktop/git/zephyr/soc/renode/cortex_r8_virtual/Kconfig.soc"
osource "/Users/ryosaitoh/Desktop/git/zephyr/soc/renesas/smartbond/Kconfig.soc"
osource "/Users/ryosaitoh/Desktop/git/zephyr/soc/renesas/rzt2m/Kconfig.soc"
osource "/Users/ryosaitoh/Desktop/git/zephyr/soc/renesas/rz/Kconfig.soc"
osource "/Users/ryosaitoh/Desktop/git/zephyr/soc/renesas/rcar/Kconfig.soc"
osource "/Users/ryosaitoh/Desktop/git/zephyr/soc/renesas/ra/Kconfig.soc"
osource "/Users/ryosaitoh/Desktop/git/zephyr/soc/realtek/ec/Kconfig.soc"
osource "/Users/ryosaitoh/Desktop/git/zephyr/soc/raspberrypi/rpi_pico/Kconfig.soc"
osource "/Users/ryosaitoh/Desktop/git/zephyr/soc/quicklogic/eos_s3/Kconfig.soc"
osource "/Users/ryosaitoh/Desktop/git/zephyr/soc/qemu/virt_riscv/Kconfig.soc"
osource "/Users/ryosaitoh/Desktop/git/zephyr/soc/qemu/malta/Kconfig.soc"
osource "/Users/ryosaitoh/Desktop/git/zephyr/soc/openisa/rv32m1/Kconfig.soc"
osource "/Users/ryosaitoh/Desktop/git/zephyr/soc/nxp/s32/Kconfig.soc"
osource "/Users/ryosaitoh/Desktop/git/zephyr/soc/nxp/rw/Kconfig.soc"
osource "/Users/ryosaitoh/Desktop/git/zephyr/soc/nxp/mcx/Kconfig.soc"
osource "/Users/ryosaitoh/Desktop/git/zephyr/soc/nxp/lpc/Kconfig.soc"
osource "/Users/ryosaitoh/Desktop/git/zephyr/soc/nxp/layerscape/Kconfig.soc"
osource "/Users/ryosaitoh/Desktop/git/zephyr/soc/nxp/kinetis/Kconfig.soc"
osource "/Users/ryosaitoh/Desktop/git/zephyr/soc/nxp/imxrt/Kconfig.soc"
osource "/Users/ryosaitoh/Desktop/git/zephyr/soc/nxp/imx/Kconfig.soc"
osource "/Users/ryosaitoh/Desktop/git/zephyr/soc/nuvoton/numicro/Kconfig.soc"
osource "/Users/ryosaitoh/Desktop/git/zephyr/soc/nuvoton/numaker/Kconfig.soc"
osource "/Users/ryosaitoh/Desktop/git/zephyr/soc/nuvoton/npcx/Kconfig.soc"
osource "/Users/ryosaitoh/Desktop/git/zephyr/soc/nuvoton/npcm/Kconfig.soc"
osource "/Users/ryosaitoh/Desktop/git/zephyr/soc/nordic/Kconfig.soc"
osource "/Users/ryosaitoh/Desktop/git/zephyr/soc/neorv32/Kconfig.soc"
osource "/Users/ryosaitoh/Desktop/git/zephyr/soc/native/inf_clock/Kconfig.soc"
osource "/Users/ryosaitoh/Desktop/git/zephyr/soc/microchip/miv/Kconfig.soc"
osource "/Users/ryosaitoh/Desktop/git/zephyr/soc/microchip/mec/Kconfig.soc"
osource "/Users/ryosaitoh/Desktop/git/zephyr/soc/mediatek/mt8xxx/Kconfig.soc"
osource "/Users/ryosaitoh/Desktop/git/zephyr/soc/lowrisc/opentitan/Kconfig.soc"
osource "/Users/ryosaitoh/Desktop/git/zephyr/soc/litex/litex_vexriscv/Kconfig.soc"
osource "/Users/ryosaitoh/Desktop/git/zephyr/soc/ite/ec/Kconfig.soc"
osource "/Users/ryosaitoh/Desktop/git/zephyr/soc/intel/raptor_lake/Kconfig.soc"
osource "/Users/ryosaitoh/Desktop/git/zephyr/soc/intel/lakemont/Kconfig.soc"
osource "/Users/ryosaitoh/Desktop/git/zephyr/soc/intel/intel_socfpga_std/Kconfig.soc"
osource "/Users/ryosaitoh/Desktop/git/zephyr/soc/intel/intel_socfpga/Kconfig.soc"
osource "/Users/ryosaitoh/Desktop/git/zephyr/soc/intel/intel_niosv/Kconfig.soc"
osource "/Users/ryosaitoh/Desktop/git/zephyr/soc/intel/intel_ish/Kconfig.soc"
osource "/Users/ryosaitoh/Desktop/git/zephyr/soc/intel/intel_adsp/Kconfig.soc"
osource "/Users/ryosaitoh/Desktop/git/zephyr/soc/intel/elkhart_lake/Kconfig.soc"
osource "/Users/ryosaitoh/Desktop/git/zephyr/soc/intel/atom/Kconfig.soc"
osource "/Users/ryosaitoh/Desktop/git/zephyr/soc/intel/apollo_lake/Kconfig.soc"
osource "/Users/ryosaitoh/Desktop/git/zephyr/soc/intel/alder_lake/Kconfig.soc"
osource "/Users/ryosaitoh/Desktop/git/zephyr/soc/infineon/cat3/Kconfig.soc"
osource "/Users/ryosaitoh/Desktop/git/zephyr/soc/infineon/cat1b/Kconfig.soc"
osource "/Users/ryosaitoh/Desktop/git/zephyr/soc/infineon/cat1a/Kconfig.soc"
osource "/Users/ryosaitoh/Desktop/git/zephyr/soc/gd/gd32/Kconfig.soc"
osource "/Users/ryosaitoh/Desktop/git/zephyr/soc/gaisler/leon3/Kconfig.soc"
osource "/Users/ryosaitoh/Desktop/git/zephyr/soc/gaisler/gr716a/Kconfig.soc"
osource "/Users/ryosaitoh/Desktop/git/zephyr/soc/espressif/Kconfig.soc"
osource "/Users/ryosaitoh/Desktop/git/zephyr/soc/ene/kb1200/Kconfig.soc"
osource "/Users/ryosaitoh/Desktop/git/zephyr/soc/efinix/sapphire/Kconfig.soc"
osource "/Users/ryosaitoh/Desktop/git/zephyr/soc/cdns/xtensa_sample_controller/Kconfig.soc"
osource "/Users/ryosaitoh/Desktop/git/zephyr/soc/cdns/sample_controller32/Kconfig.soc"
osource "/Users/ryosaitoh/Desktop/git/zephyr/soc/cdns/dc233c/Kconfig.soc"
osource "/Users/ryosaitoh/Desktop/git/zephyr/soc/brcm/bcmvk/Kconfig.soc"
osource "/Users/ryosaitoh/Desktop/git/zephyr/soc/brcm/bcm2712/Kconfig.soc"
osource "/Users/ryosaitoh/Desktop/git/zephyr/soc/brcm/bcm2711/Kconfig.soc"
osource "/Users/ryosaitoh/Desktop/git/zephyr/soc/atmel/sam0/Kconfig.soc"
osource "/Users/ryosaitoh/Desktop/git/zephyr/soc/atmel/sam/Kconfig.soc"
osource "/Users/ryosaitoh/Desktop/git/zephyr/soc/aspeed/Kconfig.soc"
osource "/Users/ryosaitoh/Desktop/git/zephyr/soc/arm/Kconfig.soc"
osource "/Users/ryosaitoh/Desktop/git/zephyr/soc/arm/beetle/Kconfig.soc"
osource "/Users/ryosaitoh/Desktop/git/zephyr/soc/antmicro/myra/Kconfig.soc"
osource "/Users/ryosaitoh/Desktop/git/zephyr/soc/andestech/Kconfig.soc"
osource "/Users/ryosaitoh/Desktop/git/zephyr/soc/amd/acp_6_0/Kconfig.soc"
osource "/Users/ryosaitoh/Desktop/git/zephyr/soc/ambiq/Kconfig.soc"
osource "/Users/ryosaitoh/Desktop/git/zephyr/soc/altr/zephyr_nios2f/Kconfig.soc"
osource "/Users/ryosaitoh/Desktop/git/zephyr/soc/altr/qemu_nios2/Kconfig.soc"
osource "/Users/ryosaitoh/Desktop/git/zephyr/soc/adi/max32/Kconfig.soc"
```

## build/right/Kconfig/Kconfig.shield
```kconfig
osource "/Users/ryosaitoh/Desktop/git/zmk-rgbled-widget/boards/shields/*/Kconfig.shield"
osource "/Users/ryosaitoh/Desktop/git/modules/prospector-zmk-module/boards/shields/*/Kconfig.shield"
osource "/Users/ryosaitoh/Desktop/git/zmk/app/boards/shields/*/Kconfig.shield"
osource "/Users/ryosaitoh/Desktop/git/zmk-config-cool642tb/config/boards/shields/*/Kconfig.shield"
```

## build/right/Kconfig/Kconfig.shield.defconfig
```kconfig
osource "/Users/ryosaitoh/Desktop/git/zmk-rgbled-widget/boards/shields/*/Kconfig.defconfig"
osource "/Users/ryosaitoh/Desktop/git/modules/prospector-zmk-module/boards/shields/*/Kconfig.defconfig"
osource "/Users/ryosaitoh/Desktop/git/zmk/app/boards/shields/*/Kconfig.defconfig"
osource "/Users/ryosaitoh/Desktop/git/zmk-config-cool642tb/config/boards/shields/*/Kconfig.defconfig"
```

## build/right/Kconfig/arch/Kconfig
```kconfig
# Load Zephyr Arch Kconfig descriptions.
osource "/Users/ryosaitoh/Desktop/git/zephyr/arch/x86/Kconfig"
osource "/Users/ryosaitoh/Desktop/git/zephyr/arch/xtensa/Kconfig"
osource "/Users/ryosaitoh/Desktop/git/zephyr/arch/sparc/Kconfig"
osource "/Users/ryosaitoh/Desktop/git/zephyr/arch/riscv/Kconfig"
osource "/Users/ryosaitoh/Desktop/git/zephyr/arch/posix/Kconfig"
osource "/Users/ryosaitoh/Desktop/git/zephyr/arch/nios2/Kconfig"
osource "/Users/ryosaitoh/Desktop/git/zephyr/arch/mips/Kconfig"
osource "/Users/ryosaitoh/Desktop/git/zephyr/arch/arm64/Kconfig"
osource "/Users/ryosaitoh/Desktop/git/zephyr/arch/arm/Kconfig"
osource "/Users/ryosaitoh/Desktop/git/zephyr/arch/arc/Kconfig"
```

## build/right/Kconfig/soc/Kconfig
```kconfig
# Load Zephyr SoC Kconfig descriptions.
osource "/Users/ryosaitoh/Desktop/git/zephyr/soc/xlnx/zynqmp/Kconfig"
osource "/Users/ryosaitoh/Desktop/git/zephyr/soc/xlnx/zynq7000/Kconfig"
osource "/Users/ryosaitoh/Desktop/git/zephyr/soc/xen/Kconfig"
osource "/Users/ryosaitoh/Desktop/git/zephyr/soc/wch/ch32v/Kconfig"
osource "/Users/ryosaitoh/Desktop/git/zephyr/soc/ti/simplelink/Kconfig"
osource "/Users/ryosaitoh/Desktop/git/zephyr/soc/ti/lm3s6965/Kconfig"
osource "/Users/ryosaitoh/Desktop/git/zephyr/soc/ti/k3/Kconfig"
osource "/Users/ryosaitoh/Desktop/git/zephyr/soc/telink/tlsr/Kconfig"
osource "/Users/ryosaitoh/Desktop/git/zephyr/soc/starfive/jh71xx/Kconfig"
osource "/Users/ryosaitoh/Desktop/git/zephyr/soc/st/stm32/Kconfig"
osource "/Users/ryosaitoh/Desktop/git/zephyr/soc/snps/qemu_arc/Kconfig"
osource "/Users/ryosaitoh/Desktop/git/zephyr/soc/snps/nsim/arc_v/Kconfig"
osource "/Users/ryosaitoh/Desktop/git/zephyr/soc/snps/nsim/arc_classic/Kconfig"
osource "/Users/ryosaitoh/Desktop/git/zephyr/soc/snps/hsdk4xd/Kconfig"
osource "/Users/ryosaitoh/Desktop/git/zephyr/soc/snps/hsdk/Kconfig"
osource "/Users/ryosaitoh/Desktop/git/zephyr/soc/snps/emsk/Kconfig"
osource "/Users/ryosaitoh/Desktop/git/zephyr/soc/snps/emsdp/Kconfig"
osource "/Users/ryosaitoh/Desktop/git/zephyr/soc/snps/arc_iot/Kconfig"
osource "/Users/ryosaitoh/Desktop/git/zephyr/soc/silabs/Kconfig"
osource "/Users/ryosaitoh/Desktop/git/zephyr/soc/sifive/sifive_freedom/Kconfig"
osource "/Users/ryosaitoh/Desktop/git/zephyr/soc/sensry/Kconfig"
osource "/Users/ryosaitoh/Desktop/git/zephyr/soc/rockchip/Kconfig"
osource "/Users/ryosaitoh/Desktop/git/zephyr/soc/renode/riscv_virtual/Kconfig"
osource "/Users/ryosaitoh/Desktop/git/zephyr/soc/renode/cortex_r8_virtual/Kconfig"
osource "/Users/ryosaitoh/Desktop/git/zephyr/soc/renesas/smartbond/Kconfig"
osource "/Users/ryosaitoh/Desktop/git/zephyr/soc/renesas/rzt2m/Kconfig"
osource "/Users/ryosaitoh/Desktop/git/zephyr/soc/renesas/rz/Kconfig"
osource "/Users/ryosaitoh/Desktop/git/zephyr/soc/renesas/rcar/Kconfig"
osource "/Users/ryosaitoh/Desktop/git/zephyr/soc/renesas/ra/Kconfig"
osource "/Users/ryosaitoh/Desktop/git/zephyr/soc/realtek/ec/Kconfig"
osource "/Users/ryosaitoh/Desktop/git/zephyr/soc/raspberrypi/rpi_pico/Kconfig"
osource "/Users/ryosaitoh/Desktop/git/zephyr/soc/quicklogic/eos_s3/Kconfig"
osource "/Users/ryosaitoh/Desktop/git/zephyr/soc/qemu/virt_riscv/Kconfig"
osource "/Users/ryosaitoh/Desktop/git/zephyr/soc/qemu/malta/Kconfig"
osource "/Users/ryosaitoh/Desktop/git/zephyr/soc/openisa/rv32m1/Kconfig"
osource "/Users/ryosaitoh/Desktop/git/zephyr/soc/nxp/s32/Kconfig"
osource "/Users/ryosaitoh/Desktop/git/zephyr/soc/nxp/rw/Kconfig"
osource "/Users/ryosaitoh/Desktop/git/zephyr/soc/nxp/mcx/Kconfig"
osource "/Users/ryosaitoh/Desktop/git/zephyr/soc/nxp/lpc/Kconfig"
osource "/Users/ryosaitoh/Desktop/git/zephyr/soc/nxp/layerscape/Kconfig"
osource "/Users/ryosaitoh/Desktop/git/zephyr/soc/nxp/kinetis/Kconfig"
osource "/Users/ryosaitoh/Desktop/git/zephyr/soc/nxp/imxrt/Kconfig"
osource "/Users/ryosaitoh/Desktop/git/zephyr/soc/nxp/imx/Kconfig"
osource "/Users/ryosaitoh/Desktop/git/zephyr/soc/nuvoton/numicro/Kconfig"
osource "/Users/ryosaitoh/Desktop/git/zephyr/soc/nuvoton/numaker/Kconfig"
osource "/Users/ryosaitoh/Desktop/git/zephyr/soc/nuvoton/npcx/Kconfig"
osource "/Users/ryosaitoh/Desktop/git/zephyr/soc/nuvoton/npcm/Kconfig"
osource "/Users/ryosaitoh/Desktop/git/zephyr/soc/nordic/Kconfig"
osource "/Users/ryosaitoh/Desktop/git/zephyr/soc/neorv32/Kconfig"
osource "/Users/ryosaitoh/Desktop/git/zephyr/soc/native/inf_clock/Kconfig"
osource "/Users/ryosaitoh/Desktop/git/zephyr/soc/microchip/miv/Kconfig"
osource "/Users/ryosaitoh/Desktop/git/zephyr/soc/microchip/mec/Kconfig"
osource "/Users/ryosaitoh/Desktop/git/zephyr/soc/mediatek/mt8xxx/Kconfig"
osource "/Users/ryosaitoh/Desktop/git/zephyr/soc/lowrisc/opentitan/Kconfig"
osource "/Users/ryosaitoh/Desktop/git/zephyr/soc/litex/litex_vexriscv/Kconfig"
osource "/Users/ryosaitoh/Desktop/git/zephyr/soc/ite/ec/Kconfig"
osource "/Users/ryosaitoh/Desktop/git/zephyr/soc/intel/raptor_lake/Kconfig"
osource "/Users/ryosaitoh/Desktop/git/zephyr/soc/intel/lakemont/Kconfig"
osource "/Users/ryosaitoh/Desktop/git/zephyr/soc/intel/intel_socfpga_std/Kconfig"
osource "/Users/ryosaitoh/Desktop/git/zephyr/soc/intel/intel_socfpga/Kconfig"
osource "/Users/ryosaitoh/Desktop/git/zephyr/soc/intel/intel_niosv/Kconfig"
osource "/Users/ryosaitoh/Desktop/git/zephyr/soc/intel/intel_ish/Kconfig"
osource "/Users/ryosaitoh/Desktop/git/zephyr/soc/intel/intel_adsp/Kconfig"
osource "/Users/ryosaitoh/Desktop/git/zephyr/soc/intel/elkhart_lake/Kconfig"
osource "/Users/ryosaitoh/Desktop/git/zephyr/soc/intel/atom/Kconfig"
osource "/Users/ryosaitoh/Desktop/git/zephyr/soc/intel/apollo_lake/Kconfig"
osource "/Users/ryosaitoh/Desktop/git/zephyr/soc/intel/alder_lake/Kconfig"
osource "/Users/ryosaitoh/Desktop/git/zephyr/soc/infineon/cat3/Kconfig"
osource "/Users/ryosaitoh/Desktop/git/zephyr/soc/infineon/cat1b/Kconfig"
osource "/Users/ryosaitoh/Desktop/git/zephyr/soc/infineon/cat1a/Kconfig"
osource "/Users/ryosaitoh/Desktop/git/zephyr/soc/gd/gd32/Kconfig"
osource "/Users/ryosaitoh/Desktop/git/zephyr/soc/gaisler/leon3/Kconfig"
osource "/Users/ryosaitoh/Desktop/git/zephyr/soc/gaisler/gr716a/Kconfig"
osource "/Users/ryosaitoh/Desktop/git/zephyr/soc/espressif/Kconfig"
osource "/Users/ryosaitoh/Desktop/git/zephyr/soc/ene/kb1200/Kconfig"
osource "/Users/ryosaitoh/Desktop/git/zephyr/soc/efinix/sapphire/Kconfig"
osource "/Users/ryosaitoh/Desktop/git/zephyr/soc/cdns/xtensa_sample_controller/Kconfig"
osource "/Users/ryosaitoh/Desktop/git/zephyr/soc/cdns/sample_controller32/Kconfig"
osource "/Users/ryosaitoh/Desktop/git/zephyr/soc/cdns/dc233c/Kconfig"
osource "/Users/ryosaitoh/Desktop/git/zephyr/soc/brcm/bcmvk/Kconfig"
osource "/Users/ryosaitoh/Desktop/git/zephyr/soc/brcm/bcm2712/Kconfig"
osource "/Users/ryosaitoh/Desktop/git/zephyr/soc/brcm/bcm2711/Kconfig"
osource "/Users/ryosaitoh/Desktop/git/zephyr/soc/atmel/sam0/Kconfig"
osource "/Users/ryosaitoh/Desktop/git/zephyr/soc/atmel/sam/Kconfig"
osource "/Users/ryosaitoh/Desktop/git/zephyr/soc/aspeed/Kconfig"
osource "/Users/ryosaitoh/Desktop/git/zephyr/soc/arm/Kconfig"
osource "/Users/ryosaitoh/Desktop/git/zephyr/soc/arm/beetle/Kconfig"
osource "/Users/ryosaitoh/Desktop/git/zephyr/soc/antmicro/myra/Kconfig"
osource "/Users/ryosaitoh/Desktop/git/zephyr/soc/andestech/Kconfig"
osource "/Users/ryosaitoh/Desktop/git/zephyr/soc/amd/acp_6_0/Kconfig"
osource "/Users/ryosaitoh/Desktop/git/zephyr/soc/ambiq/Kconfig"
osource "/Users/ryosaitoh/Desktop/git/zephyr/soc/altr/zephyr_nios2f/Kconfig"
osource "/Users/ryosaitoh/Desktop/git/zephyr/soc/altr/qemu_nios2/Kconfig"
osource "/Users/ryosaitoh/Desktop/git/zephyr/soc/adi/max32/Kconfig"
```

## config/west.yml
```yaml
manifest:
  remotes:
    - name: zmkfirmware
      url-base: https://github.com/zmkfirmware
    - name: razilyis
      url-base: https://github.com/razilyis
  projects:
    - name: zmk
      remote: zmkfirmware
      revision: v0.3-branch
      import: app/west.yml
    - name: zmk-driver-paw3222
      remote: razilyis
      revision: main
  self:
    path: config
    
```
